/* Gods: link script for m68k-amigaos-ld -m amiga.  Generated by scripts/gen_gods_data.py.
 *
 * The data hunk is laid out so that an object's offset in it is the address the original keeps it at; it is
 * loaded at address 0, and only the bytes of the listed objects are ever written to memory.  SUBALIGN(1) because
 * the original keeps byte variables at odd addresses.  The code, and the data that only the code uses, follow in
 * a hunk of their own, which the loader places in memory the original does not use. */
SECTIONS {
    .data : SUBALIGN(1) {
        . = 0x0; *(.data.vectors) *(.rodata.vectors) *(.bss.vectors)
        . = 0xa8; *(.data.copper_a) *(.rodata.copper_a) *(.bss.copper_a)
        . = 0xfc; *(.data.copper_b) *(.rodata.copper_b) *(.bss.copper_b)
        . = 0xe96; *(.data.glyph_plane_size) *(.rodata.glyph_plane_size) *(.bss.glyph_plane_size)
        . = 0x169a; *(.data.scroll_y) *(.rodata.scroll_y) *(.bss.scroll_y)
        . = 0x169e; *(.data.scroll_step) *(.rodata.scroll_step) *(.bss.scroll_step)
        . = 0x1af6; *(.data.palette_ptr) *(.rodata.palette_ptr) *(.bss.palette_ptr)
        . = 0x1dd2; *(.data.flags) *(.rodata.flags) *(.bss.flags)
        . = 0x1e3c; *(.data.game_clock) *(.rodata.game_clock) *(.bss.game_clock)
        . = 0x27e0; *(.data.vibrato_table) *(.rodata.vibrato_table) *(.bss.vibrato_table)
        . = 0x2800; *(.data.period_table) *(.rodata.period_table) *(.bss.period_table)
        . = 0x284c; *(.data.music) *(.rodata.music) *(.bss.music)
        . = 0x2854; *(.data.sample_start) *(.rodata.sample_start) *(.bss.sample_start)
        . = 0x28d0; *(.data.channel) *(.rodata.channel) *(.bss.channel)
        . = 0x2940; *(.data.screen_front) *(.rodata.screen_front) *(.bss.screen_front)
        . = 0x2944; *(.data.screen_back) *(.rodata.screen_back) *(.bss.screen_back)
        . = 0x2948; *(.data.display) *(.rodata.display) *(.bss.display)
        . = 0x2cb0; *(.data.draw_flag) *(.rodata.draw_flag) *(.bss.draw_flag)
        . = 0x2cc2; *(.data.vblank) *(.rodata.vblank) *(.bss.vblank)
        . = 0x3486; *(.data.blank_plane) *(.rodata.blank_plane) *(.bss.blank_plane)
        . = 0x394a; *(.data.font_offset) *(.rodata.font_offset) *(.bss.font_offset)
        . = 0x3a62; *(.data.graphics) *(.rodata.graphics) *(.bss.graphics)
        . = 0x1b6f2; *(.data.module) *(.rodata.module) *(.bss.module)
        . = 0x6c780; *(.data.screen_b) *(.rodata.screen_b) *(.bss.screen_b)
        . = 0x763c0; *(.data.screen_a) *(.rodata.screen_a) *(.bss.screen_a)
    }
    .text : { *(.text .text.*) *(.rodata .rodata.*) *(.data .data.*) *(.bss .bss.*) *(COMMON) }
}
